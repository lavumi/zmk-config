## config/west.yml
```yaml
manifest:
  remotes:
    - name: zmkfirmware
      url-base: https://github.com/zmkfirmware
    - name: lavumi
      url-base: https://github.com/lavumi
  projects:
    - name: zmk
      remote: zmkfirmware
      revision: v0.3.0
      import: app/west.yml
    - name: nice-view-mod
      remote: lavumi
      revision: main
    - name: zmk-keyboards-totem
      url: https://github.com/victorlucachi/zmk-keyboards-totem
      revision: main
      path: modules/zmk-keyboards-totem
  self:
    path: config
```
